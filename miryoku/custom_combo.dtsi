/ {
    combos {
        compatible = "zmk,combos";

        combo_language_switch {
            timeout-ms = <50>;
            bindings = <&kp F13>;
            key-positions = <26 27>;
        };
    };
};
